## meta-scobc/conf/machine/versal-scobc-v1-ve2302i-reva-sdt-full.conf
```bitbake
#@TYPE: Machine
#@NAME: versal-scobc-v1-ve2302i-reva-sdt-full
#@DESCRIPTION: Machine configuration for the versal-scobc-v1-ve2302i-reva-sdt-full boards.


BBMULTICONFIG += "versal-scobc-v1-ve2302i-reva-sdt-full-microblaze-pmc versal-scobc-v1-ve2302i-reva-sdt-full-microblaze-psm"

#### Preamble
MACHINEOVERRIDES =. "${@['', 'versal-scobc-v1-ve2302i-reva-sdt-full:']['versal-scobc-v1-ve2302i-reva-sdt-full' !='${MACHINE}']}"
#### Regular settings follow
TUNEFILE[microblaze-pmc] = "conf/machine/include/versal-scobc-v1-ve2302i-reva-sdt-full/microblaze.inc"
TUNEFILE[microblaze-psm] = "conf/machine/include/versal-scobc-v1-ve2302i-reva-sdt-full/microblaze.inc"

# Platform Loader and Manager
PLM_DEPENDS = ""
PLM_MCDEPENDS = "mc::versal-scobc-v1-ve2302i-reva-sdt-full-microblaze-pmc:plm-firmware:do_deploy"
PLM_DEPLOY_DIR = "${TMPDIR}-versal-scobc-v1-ve2302i-reva-sdt-full-microblaze-pmc/deploy/images/${MACHINE}"

# PSM Firware
PSM_DEPENDS = ""
PSM_MCDEPENDS = "mc::versal-scobc-v1-ve2302i-reva-sdt-full-microblaze-psm:psm-firmware:do_deploy"
PSM_FIRMWARE_DEPLOY_DIR = "${TMPDIR}-versal-scobc-v1-ve2302i-reva-sdt-full-microblaze-psm/deploy/images/${MACHINE}"

# Set the default (linux) domain device tree
CONFIG_DTFILE_DIR := "${@bb.utils.which(d.getVar('BBPATH'), 'conf/dts/versal-scobc-v1-ve2302i-reva-sdt-full')}"
CONFIG_DTFILE ?= "${CONFIG_DTFILE_DIR}/cortexa72-linux.dts"
CONFIG_DTFILE[vardepsexclude] += "CONFIG_DTFILE_DIR"

# Yocto arm-trusted-firmware(TF-A) variables
TFA_CONSOLE ?= "pl011"
TFA_BL33_LOAD ?= "0x8000000"

# Set DDR Base address for u-boot-xlnx-scr variables
DDR_BASEADDR ?= "0x0"
SKIP_APPEND_BASEADDR ?= "0"

# Yocto KERNEL Variables
UBOOT_ENTRYPOINT  ?= "0x200000"
UBOOT_LOADADDRESS ?= "0x200000"

# Yocto MACHINE_FEATURES Variable
MACHINE_FEATURES += "vdu fpga-overlay"

# Load the SC-OBC Module V1 Rev.A configuration
require conf/machine/include/scobc-v1-reva.inc

# Required generic machine inclusion
require conf/machine/scobc-v1-generic.conf

# Load the dualboot U-Boot configuration when provided by meta-scobc-dualboot
include conf/machine/include/scobc-v1-u-boot.conf
# Safety processor firmware run by QEMU alongside the Versal model
SP_FIRMWARE_URI ?= "https://downloads.spacecubics.com/products/scobc-v1/releases/v2026.10/sp-firmware/zephyr.elf;downloadfilename=scobc-v1-sp-firmware-v2026.10.elf"
SP_FIRMWARE_URI[sha256sum] ?= "88aecc434fd761a75269ae928d5ec431001786a867b1fe2af5da4291c3617715"

# This is an 'SDT' based BSP
XILINX_WITH_ESW = "sdt"

# Original SDT artifacts URL
SDT_URI = "https://downloads.spacecubics.com/products/scobc-v1/releases/v2026.10/sdt/versal-scobc-v1-ve2302i-reva.tar.gz"
SDT_URI[sha256sum] = "8a14e42f9a6b9e683072aa08470bac468dbedcd9f95a6276c9f5300c2e4f3e6b"
SDT_URI[S] = "${WORKDIR}/versal-scobc-v1-ve2302i-reva"

# Set the system device trees
SYSTEM_DTFILE_DEPENDS = "sdt-artifacts"
SYSTEM_DTFILE_DIR = "${RECIPE_SYSROOT}${datadir}/sdt/${MACHINE}"
SYSTEM_DTFILE = "${SYSTEM_DTFILE_DIR}/system-top.dts"

# Load the dynamic machine features
include conf/machine/include/versal-scobc-v1-ve2302i-reva-sdt-full/${BB_CURRENT_MC}-features.conf
LIBXIL_CONFIG = "conf/machine/include/versal-scobc-v1-ve2302i-reva-sdt-full/${BB_CURRENT_MC}-libxil.conf"

# Versal PDI
PDI_PATH_DEPENDS = "sdt-artifacts"
PDI_PATH_DIR = "${RECIPE_SYSROOT}${datadir}/sdt/${MACHINE}"
PDI_PATH = "${PDI_PATH_DIR}/sc_obc_v1_versal_e51e712a.pdi"

# Update bootbin to use proper device tree
BIF_PARTITION_IMAGE[device-tree] = "${RECIPE_SYSROOT}/boot/devicetree/${@os.path.basename(d.getVar('CONFIG_DTFILE').replace('.dts', '.dtb'))}"

# Remap boot files to ensure the right device tree is listed first
IMAGE_BOOT_FILES =+ "devicetree/${@os.path.basename(d.getVar('CONFIG_DTFILE').replace('.dts', '.dtb'))}"

#### No additional settings should be after the Postamble
#### Postamble
PACKAGE_EXTRA_ARCHS:append = "${@['', ' versal_scobc_v1_ve2302i_reva_sdt_full']['versal-scobc-v1-ve2302i-reva-sdt-full' != '${MACHINE}']}"
```
